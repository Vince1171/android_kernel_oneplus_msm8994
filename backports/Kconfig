## backports/Kconfig
```kconfig
config BACKPORT_INTEGRATE
	bool
	def_bool y

config BACKPORT_DIR
	string
	default "backports/"

config BACKPORT_VERSION
	string
	default "v4.0.1-1-0-g807a2bbf"

config BACKPORT_KERNEL_VERSION
	string
	default "v4.0-0-g39a8804455fb"

config BACKPORT_KERNEL_NAME
	string
	default "Linux"

menuconfig BACKPORT_LINUX
	bool "Backport Linux v4.0-0-g39a8804455fb (backports v4.0.1-1-0-g807a2bbf)"
	default n
	---help---
	  Enabling this will let give you the opportunity to use features and
	  drivers backported from Linux v4.0-0-g39a8804455fb
	  on the kernel your are using. This is experimental and you should
	  say no unless you'd like to help test things or want to help debug
	  this should we run into any issues.

if BACKPORT_LINUX

source "$BACKPORT_DIR/Kconfig.versions"
source "$BACKPORT_DIR/Kconfig.sources"

endif # BACKPORT_LINUX
```
